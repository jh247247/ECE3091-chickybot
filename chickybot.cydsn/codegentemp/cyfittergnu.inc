.ifndef INCLUDED_CYFITTERGNU_INC
.set INCLUDED_CYFITTERGNU_INC, 1
.include "cydevicegnu.inc"
.include "cydevicegnu_trm.inc"

/* Lcd_Cntl_Port */
.set Lcd_Cntl_Port_Sync_ctrl_reg__0__MASK, 0x01
.set Lcd_Cntl_Port_Sync_ctrl_reg__0__POS, 0
.set Lcd_Cntl_Port_Sync_ctrl_reg__1__MASK, 0x02
.set Lcd_Cntl_Port_Sync_ctrl_reg__1__POS, 1
.set Lcd_Cntl_Port_Sync_ctrl_reg__16BIT_CONTROL_AUX_CTL_REG, CYREG_B0_UDB02_03_ACTL
.set Lcd_Cntl_Port_Sync_ctrl_reg__16BIT_CONTROL_CONTROL_REG, CYREG_B0_UDB02_03_CTL
.set Lcd_Cntl_Port_Sync_ctrl_reg__16BIT_CONTROL_COUNT_REG, CYREG_B0_UDB02_03_CTL
.set Lcd_Cntl_Port_Sync_ctrl_reg__16BIT_COUNT_CONTROL_REG, CYREG_B0_UDB02_03_CTL
.set Lcd_Cntl_Port_Sync_ctrl_reg__16BIT_COUNT_COUNT_REG, CYREG_B0_UDB02_03_CTL
.set Lcd_Cntl_Port_Sync_ctrl_reg__16BIT_MASK_MASK_REG, CYREG_B0_UDB02_03_MSK
.set Lcd_Cntl_Port_Sync_ctrl_reg__16BIT_MASK_PERIOD_REG, CYREG_B0_UDB02_03_MSK
.set Lcd_Cntl_Port_Sync_ctrl_reg__16BIT_PERIOD_MASK_REG, CYREG_B0_UDB02_03_MSK
.set Lcd_Cntl_Port_Sync_ctrl_reg__16BIT_PERIOD_PERIOD_REG, CYREG_B0_UDB02_03_MSK
.set Lcd_Cntl_Port_Sync_ctrl_reg__2__MASK, 0x04
.set Lcd_Cntl_Port_Sync_ctrl_reg__2__POS, 2
.set Lcd_Cntl_Port_Sync_ctrl_reg__3__MASK, 0x08
.set Lcd_Cntl_Port_Sync_ctrl_reg__3__POS, 3
.set Lcd_Cntl_Port_Sync_ctrl_reg__4__MASK, 0x10
.set Lcd_Cntl_Port_Sync_ctrl_reg__4__POS, 4
.set Lcd_Cntl_Port_Sync_ctrl_reg__5__MASK, 0x20
.set Lcd_Cntl_Port_Sync_ctrl_reg__5__POS, 5
.set Lcd_Cntl_Port_Sync_ctrl_reg__CONTROL_AUX_CTL_REG, CYREG_B0_UDB02_ACTL
.set Lcd_Cntl_Port_Sync_ctrl_reg__CONTROL_REG, CYREG_B0_UDB02_CTL
.set Lcd_Cntl_Port_Sync_ctrl_reg__CONTROL_ST_REG, CYREG_B0_UDB02_ST_CTL
.set Lcd_Cntl_Port_Sync_ctrl_reg__COUNT_REG, CYREG_B0_UDB02_CTL
.set Lcd_Cntl_Port_Sync_ctrl_reg__COUNT_ST_REG, CYREG_B0_UDB02_ST_CTL
.set Lcd_Cntl_Port_Sync_ctrl_reg__MASK, 0x3F
.set Lcd_Cntl_Port_Sync_ctrl_reg__MASK_CTL_AUX_CTL_REG, CYREG_B0_UDB02_MSK_ACTL
.set Lcd_Cntl_Port_Sync_ctrl_reg__PER_CTL_AUX_CTL_REG, CYREG_B0_UDB02_MSK_ACTL
.set Lcd_Cntl_Port_Sync_ctrl_reg__PERIOD_REG, CYREG_B0_UDB02_MSK

/* LcdE */
.set LcdE__0__MASK, 0x04
.set LcdE__0__PC, CYREG_PRT12_PC2
.set LcdE__0__PORT, 12
.set LcdE__0__SHIFT, 2
.set LcdE__AG, CYREG_PRT12_AG
.set LcdE__BIE, CYREG_PRT12_BIE
.set LcdE__BIT_MASK, CYREG_PRT12_BIT_MASK
.set LcdE__BYP, CYREG_PRT12_BYP
.set LcdE__DM0, CYREG_PRT12_DM0
.set LcdE__DM1, CYREG_PRT12_DM1
.set LcdE__DM2, CYREG_PRT12_DM2
.set LcdE__DR, CYREG_PRT12_DR
.set LcdE__INP_DIS, CYREG_PRT12_INP_DIS
.set LcdE__MASK, 0x04
.set LcdE__PORT, 12
.set LcdE__PRT, CYREG_PRT12_PRT
.set LcdE__PRTDSI__DBL_SYNC_IN, CYREG_PRT12_DBL_SYNC_IN
.set LcdE__PRTDSI__OE_SEL0, CYREG_PRT12_OE_SEL0
.set LcdE__PRTDSI__OE_SEL1, CYREG_PRT12_OE_SEL1
.set LcdE__PRTDSI__OUT_SEL0, CYREG_PRT12_OUT_SEL0
.set LcdE__PRTDSI__OUT_SEL1, CYREG_PRT12_OUT_SEL1
.set LcdE__PRTDSI__SYNC_OUT, CYREG_PRT12_SYNC_OUT
.set LcdE__PS, CYREG_PRT12_PS
.set LcdE__SHIFT, 2
.set LcdE__SIO_CFG, CYREG_PRT12_SIO_CFG
.set LcdE__SIO_DIFF, CYREG_PRT12_SIO_DIFF
.set LcdE__SIO_HYST_EN, CYREG_PRT12_SIO_HYST_EN
.set LcdE__SIO_REG_HIFREQ, CYREG_PRT12_SIO_REG_HIFREQ
.set LcdE__SLW, CYREG_PRT12_SLW

/* LcdRS */
.set LcdRS__0__MASK, 0x08
.set LcdRS__0__PC, CYREG_IO_PC_PRT15_PC3
.set LcdRS__0__PORT, 15
.set LcdRS__0__SHIFT, 3
.set LcdRS__AG, CYREG_PRT15_AG
.set LcdRS__AMUX, CYREG_PRT15_AMUX
.set LcdRS__BIE, CYREG_PRT15_BIE
.set LcdRS__BIT_MASK, CYREG_PRT15_BIT_MASK
.set LcdRS__BYP, CYREG_PRT15_BYP
.set LcdRS__CTL, CYREG_PRT15_CTL
.set LcdRS__DM0, CYREG_PRT15_DM0
.set LcdRS__DM1, CYREG_PRT15_DM1
.set LcdRS__DM2, CYREG_PRT15_DM2
.set LcdRS__DR, CYREG_PRT15_DR
.set LcdRS__INP_DIS, CYREG_PRT15_INP_DIS
.set LcdRS__LCD_COM_SEG, CYREG_PRT15_LCD_COM_SEG
.set LcdRS__LCD_EN, CYREG_PRT15_LCD_EN
.set LcdRS__MASK, 0x08
.set LcdRS__PORT, 15
.set LcdRS__PRT, CYREG_PRT15_PRT
.set LcdRS__PRTDSI__CAPS_SEL, CYREG_PRT15_CAPS_SEL
.set LcdRS__PRTDSI__DBL_SYNC_IN, CYREG_PRT15_DBL_SYNC_IN
.set LcdRS__PRTDSI__OE_SEL0, CYREG_PRT15_OE_SEL0
.set LcdRS__PRTDSI__OE_SEL1, CYREG_PRT15_OE_SEL1
.set LcdRS__PRTDSI__OUT_SEL0, CYREG_PRT15_OUT_SEL0
.set LcdRS__PRTDSI__OUT_SEL1, CYREG_PRT15_OUT_SEL1
.set LcdRS__PRTDSI__SYNC_OUT, CYREG_PRT15_SYNC_OUT
.set LcdRS__PS, CYREG_PRT15_PS
.set LcdRS__SHIFT, 3
.set LcdRS__SLW, CYREG_PRT15_SLW

/* LcdV0 */
.set LcdV0__0__MASK, 0x08
.set LcdV0__0__PC, CYREG_PRT12_PC3
.set LcdV0__0__PORT, 12
.set LcdV0__0__SHIFT, 3
.set LcdV0__AG, CYREG_PRT12_AG
.set LcdV0__BIE, CYREG_PRT12_BIE
.set LcdV0__BIT_MASK, CYREG_PRT12_BIT_MASK
.set LcdV0__BYP, CYREG_PRT12_BYP
.set LcdV0__DM0, CYREG_PRT12_DM0
.set LcdV0__DM1, CYREG_PRT12_DM1
.set LcdV0__DM2, CYREG_PRT12_DM2
.set LcdV0__DR, CYREG_PRT12_DR
.set LcdV0__INP_DIS, CYREG_PRT12_INP_DIS
.set LcdV0__MASK, 0x08
.set LcdV0__PORT, 12
.set LcdV0__PRT, CYREG_PRT12_PRT
.set LcdV0__PRTDSI__DBL_SYNC_IN, CYREG_PRT12_DBL_SYNC_IN
.set LcdV0__PRTDSI__OE_SEL0, CYREG_PRT12_OE_SEL0
.set LcdV0__PRTDSI__OE_SEL1, CYREG_PRT12_OE_SEL1
.set LcdV0__PRTDSI__OUT_SEL0, CYREG_PRT12_OUT_SEL0
.set LcdV0__PRTDSI__OUT_SEL1, CYREG_PRT12_OUT_SEL1
.set LcdV0__PRTDSI__SYNC_OUT, CYREG_PRT12_SYNC_OUT
.set LcdV0__PS, CYREG_PRT12_PS
.set LcdV0__SHIFT, 3
.set LcdV0__SIO_CFG, CYREG_PRT12_SIO_CFG
.set LcdV0__SIO_DIFF, CYREG_PRT12_SIO_DIFF
.set LcdV0__SIO_HYST_EN, CYREG_PRT12_SIO_HYST_EN
.set LcdV0__SIO_REG_HIFREQ, CYREG_PRT12_SIO_REG_HIFREQ
.set LcdV0__SLW, CYREG_PRT12_SLW

/* CsBtns_Button */
.set CsBtns_Button__0__AG, CYREG_PRT5_AG
.set CsBtns_Button__0__AMUX, CYREG_PRT5_AMUX
.set CsBtns_Button__0__BIE, CYREG_PRT5_BIE
.set CsBtns_Button__0__BIT_MASK, CYREG_PRT5_BIT_MASK
.set CsBtns_Button__0__BYP, CYREG_PRT5_BYP
.set CsBtns_Button__0__CTL, CYREG_PRT5_CTL
.set CsBtns_Button__0__DM0, CYREG_PRT5_DM0
.set CsBtns_Button__0__DM1, CYREG_PRT5_DM1
.set CsBtns_Button__0__DM2, CYREG_PRT5_DM2
.set CsBtns_Button__0__DR, CYREG_PRT5_DR
.set CsBtns_Button__0__INP_DIS, CYREG_PRT5_INP_DIS
.set CsBtns_Button__0__LCD_COM_SEG, CYREG_PRT5_LCD_COM_SEG
.set CsBtns_Button__0__LCD_EN, CYREG_PRT5_LCD_EN
.set CsBtns_Button__0__MASK, 0x80
.set CsBtns_Button__0__PC, CYREG_PRT5_PC7
.set CsBtns_Button__0__PORT, 5
.set CsBtns_Button__0__PRT, CYREG_PRT5_PRT
.set CsBtns_Button__0__PRTDSI__CAPS_SEL, CYREG_PRT5_CAPS_SEL
.set CsBtns_Button__0__PRTDSI__DBL_SYNC_IN, CYREG_PRT5_DBL_SYNC_IN
.set CsBtns_Button__0__PRTDSI__OE_SEL0, CYREG_PRT5_OE_SEL0
.set CsBtns_Button__0__PRTDSI__OE_SEL1, CYREG_PRT5_OE_SEL1
.set CsBtns_Button__0__PRTDSI__OUT_SEL0, CYREG_PRT5_OUT_SEL0
.set CsBtns_Button__0__PRTDSI__OUT_SEL1, CYREG_PRT5_OUT_SEL1
.set CsBtns_Button__0__PRTDSI__SYNC_OUT, CYREG_PRT5_SYNC_OUT
.set CsBtns_Button__0__PS, CYREG_PRT5_PS
.set CsBtns_Button__0__SHIFT, 7
.set CsBtns_Button__0__SLW, CYREG_PRT5_SLW
.set CsBtns_Button__1__AG, CYREG_PRT6_AG
.set CsBtns_Button__1__AMUX, CYREG_PRT6_AMUX
.set CsBtns_Button__1__BIE, CYREG_PRT6_BIE
.set CsBtns_Button__1__BIT_MASK, CYREG_PRT6_BIT_MASK
.set CsBtns_Button__1__BYP, CYREG_PRT6_BYP
.set CsBtns_Button__1__CTL, CYREG_PRT6_CTL
.set CsBtns_Button__1__DM0, CYREG_PRT6_DM0
.set CsBtns_Button__1__DM1, CYREG_PRT6_DM1
.set CsBtns_Button__1__DM2, CYREG_PRT6_DM2
.set CsBtns_Button__1__DR, CYREG_PRT6_DR
.set CsBtns_Button__1__INP_DIS, CYREG_PRT6_INP_DIS
.set CsBtns_Button__1__LCD_COM_SEG, CYREG_PRT6_LCD_COM_SEG
.set CsBtns_Button__1__LCD_EN, CYREG_PRT6_LCD_EN
.set CsBtns_Button__1__MASK, 0x10
.set CsBtns_Button__1__PC, CYREG_PRT6_PC4
.set CsBtns_Button__1__PORT, 6
.set CsBtns_Button__1__PRT, CYREG_PRT6_PRT
.set CsBtns_Button__1__PRTDSI__CAPS_SEL, CYREG_PRT6_CAPS_SEL
.set CsBtns_Button__1__PRTDSI__DBL_SYNC_IN, CYREG_PRT6_DBL_SYNC_IN
.set CsBtns_Button__1__PRTDSI__OE_SEL0, CYREG_PRT6_OE_SEL0
.set CsBtns_Button__1__PRTDSI__OE_SEL1, CYREG_PRT6_OE_SEL1
.set CsBtns_Button__1__PRTDSI__OUT_SEL0, CYREG_PRT6_OUT_SEL0
.set CsBtns_Button__1__PRTDSI__OUT_SEL1, CYREG_PRT6_OUT_SEL1
.set CsBtns_Button__1__PRTDSI__SYNC_OUT, CYREG_PRT6_SYNC_OUT
.set CsBtns_Button__1__PS, CYREG_PRT6_PS
.set CsBtns_Button__1__SHIFT, 4
.set CsBtns_Button__1__SLW, CYREG_PRT6_SLW

/* CsBtns_PWM_PWMHW */
.set CsBtns_PWM_PWMHW__CAP0, CYREG_TMR0_CAP0
.set CsBtns_PWM_PWMHW__CAP1, CYREG_TMR0_CAP1
.set CsBtns_PWM_PWMHW__CFG0, CYREG_TMR0_CFG0
.set CsBtns_PWM_PWMHW__CFG1, CYREG_TMR0_CFG1
.set CsBtns_PWM_PWMHW__CFG2, CYREG_TMR0_CFG2
.set CsBtns_PWM_PWMHW__CNT_CMP0, CYREG_TMR0_CNT_CMP0
.set CsBtns_PWM_PWMHW__CNT_CMP1, CYREG_TMR0_CNT_CMP1
.set CsBtns_PWM_PWMHW__PER0, CYREG_TMR0_PER0
.set CsBtns_PWM_PWMHW__PER1, CYREG_TMR0_PER1
.set CsBtns_PWM_PWMHW__PM_ACT_CFG, CYREG_PM_ACT_CFG3
.set CsBtns_PWM_PWMHW__PM_ACT_MSK, 0x01
.set CsBtns_PWM_PWMHW__PM_STBY_CFG, CYREG_PM_STBY_CFG3
.set CsBtns_PWM_PWMHW__PM_STBY_MSK, 0x01
.set CsBtns_PWM_PWMHW__RT0, CYREG_TMR0_RT0
.set CsBtns_PWM_PWMHW__RT1, CYREG_TMR0_RT1
.set CsBtns_PWM_PWMHW__SR0, CYREG_TMR0_SR0

/* LcdDB4 */
.set LcdDB4__0__MASK, 0x01
.set LcdDB4__0__PC, CYREG_PRT4_PC0
.set LcdDB4__0__PORT, 4
.set LcdDB4__0__SHIFT, 0
.set LcdDB4__AG, CYREG_PRT4_AG
.set LcdDB4__AMUX, CYREG_PRT4_AMUX
.set LcdDB4__BIE, CYREG_PRT4_BIE
.set LcdDB4__BIT_MASK, CYREG_PRT4_BIT_MASK
.set LcdDB4__BYP, CYREG_PRT4_BYP
.set LcdDB4__CTL, CYREG_PRT4_CTL
.set LcdDB4__DM0, CYREG_PRT4_DM0
.set LcdDB4__DM1, CYREG_PRT4_DM1
.set LcdDB4__DM2, CYREG_PRT4_DM2
.set LcdDB4__DR, CYREG_PRT4_DR
.set LcdDB4__INP_DIS, CYREG_PRT4_INP_DIS
.set LcdDB4__LCD_COM_SEG, CYREG_PRT4_LCD_COM_SEG
.set LcdDB4__LCD_EN, CYREG_PRT4_LCD_EN
.set LcdDB4__MASK, 0x01
.set LcdDB4__PORT, 4
.set LcdDB4__PRT, CYREG_PRT4_PRT
.set LcdDB4__PRTDSI__CAPS_SEL, CYREG_PRT4_CAPS_SEL
.set LcdDB4__PRTDSI__DBL_SYNC_IN, CYREG_PRT4_DBL_SYNC_IN
.set LcdDB4__PRTDSI__OE_SEL0, CYREG_PRT4_OE_SEL0
.set LcdDB4__PRTDSI__OE_SEL1, CYREG_PRT4_OE_SEL1
.set LcdDB4__PRTDSI__OUT_SEL0, CYREG_PRT4_OUT_SEL0
.set LcdDB4__PRTDSI__OUT_SEL1, CYREG_PRT4_OUT_SEL1
.set LcdDB4__PRTDSI__SYNC_OUT, CYREG_PRT4_SYNC_OUT
.set LcdDB4__PS, CYREG_PRT4_PS
.set LcdDB4__SHIFT, 0
.set LcdDB4__SLW, CYREG_PRT4_SLW

/* LcdDB5 */
.set LcdDB5__0__MASK, 0x02
.set LcdDB5__0__PC, CYREG_PRT4_PC1
.set LcdDB5__0__PORT, 4
.set LcdDB5__0__SHIFT, 1
.set LcdDB5__AG, CYREG_PRT4_AG
.set LcdDB5__AMUX, CYREG_PRT4_AMUX
.set LcdDB5__BIE, CYREG_PRT4_BIE
.set LcdDB5__BIT_MASK, CYREG_PRT4_BIT_MASK
.set LcdDB5__BYP, CYREG_PRT4_BYP
.set LcdDB5__CTL, CYREG_PRT4_CTL
.set LcdDB5__DM0, CYREG_PRT4_DM0
.set LcdDB5__DM1, CYREG_PRT4_DM1
.set LcdDB5__DM2, CYREG_PRT4_DM2
.set LcdDB5__DR, CYREG_PRT4_DR
.set LcdDB5__INP_DIS, CYREG_PRT4_INP_DIS
.set LcdDB5__LCD_COM_SEG, CYREG_PRT4_LCD_COM_SEG
.set LcdDB5__LCD_EN, CYREG_PRT4_LCD_EN
.set LcdDB5__MASK, 0x02
.set LcdDB5__PORT, 4
.set LcdDB5__PRT, CYREG_PRT4_PRT
.set LcdDB5__PRTDSI__CAPS_SEL, CYREG_PRT4_CAPS_SEL
.set LcdDB5__PRTDSI__DBL_SYNC_IN, CYREG_PRT4_DBL_SYNC_IN
.set LcdDB5__PRTDSI__OE_SEL0, CYREG_PRT4_OE_SEL0
.set LcdDB5__PRTDSI__OE_SEL1, CYREG_PRT4_OE_SEL1
.set LcdDB5__PRTDSI__OUT_SEL0, CYREG_PRT4_OUT_SEL0
.set LcdDB5__PRTDSI__OUT_SEL1, CYREG_PRT4_OUT_SEL1
.set LcdDB5__PRTDSI__SYNC_OUT, CYREG_PRT4_SYNC_OUT
.set LcdDB5__PS, CYREG_PRT4_PS
.set LcdDB5__SHIFT, 1
.set LcdDB5__SLW, CYREG_PRT4_SLW

/* LcdDB6 */
.set LcdDB6__0__MASK, 0x40
.set LcdDB6__0__PC, CYREG_PRT0_PC6
.set LcdDB6__0__PORT, 0
.set LcdDB6__0__SHIFT, 6
.set LcdDB6__AG, CYREG_PRT0_AG
.set LcdDB6__AMUX, CYREG_PRT0_AMUX
.set LcdDB6__BIE, CYREG_PRT0_BIE
.set LcdDB6__BIT_MASK, CYREG_PRT0_BIT_MASK
.set LcdDB6__BYP, CYREG_PRT0_BYP
.set LcdDB6__CTL, CYREG_PRT0_CTL
.set LcdDB6__DM0, CYREG_PRT0_DM0
.set LcdDB6__DM1, CYREG_PRT0_DM1
.set LcdDB6__DM2, CYREG_PRT0_DM2
.set LcdDB6__DR, CYREG_PRT0_DR
.set LcdDB6__INP_DIS, CYREG_PRT0_INP_DIS
.set LcdDB6__LCD_COM_SEG, CYREG_PRT0_LCD_COM_SEG
.set LcdDB6__LCD_EN, CYREG_PRT0_LCD_EN
.set LcdDB6__MASK, 0x40
.set LcdDB6__PORT, 0
.set LcdDB6__PRT, CYREG_PRT0_PRT
.set LcdDB6__PRTDSI__CAPS_SEL, CYREG_PRT0_CAPS_SEL
.set LcdDB6__PRTDSI__DBL_SYNC_IN, CYREG_PRT0_DBL_SYNC_IN
.set LcdDB6__PRTDSI__OE_SEL0, CYREG_PRT0_OE_SEL0
.set LcdDB6__PRTDSI__OE_SEL1, CYREG_PRT0_OE_SEL1
.set LcdDB6__PRTDSI__OUT_SEL0, CYREG_PRT0_OUT_SEL0
.set LcdDB6__PRTDSI__OUT_SEL1, CYREG_PRT0_OUT_SEL1
.set LcdDB6__PRTDSI__SYNC_OUT, CYREG_PRT0_SYNC_OUT
.set LcdDB6__PS, CYREG_PRT0_PS
.set LcdDB6__SHIFT, 6
.set LcdDB6__SLW, CYREG_PRT0_SLW

/* LcdDB7 */
.set LcdDB7__0__MASK, 0x80
.set LcdDB7__0__PC, CYREG_PRT0_PC7
.set LcdDB7__0__PORT, 0
.set LcdDB7__0__SHIFT, 7
.set LcdDB7__AG, CYREG_PRT0_AG
.set LcdDB7__AMUX, CYREG_PRT0_AMUX
.set LcdDB7__BIE, CYREG_PRT0_BIE
.set LcdDB7__BIT_MASK, CYREG_PRT0_BIT_MASK
.set LcdDB7__BYP, CYREG_PRT0_BYP
.set LcdDB7__CTL, CYREG_PRT0_CTL
.set LcdDB7__DM0, CYREG_PRT0_DM0
.set LcdDB7__DM1, CYREG_PRT0_DM1
.set LcdDB7__DM2, CYREG_PRT0_DM2
.set LcdDB7__DR, CYREG_PRT0_DR
.set LcdDB7__INP_DIS, CYREG_PRT0_INP_DIS
.set LcdDB7__LCD_COM_SEG, CYREG_PRT0_LCD_COM_SEG
.set LcdDB7__LCD_EN, CYREG_PRT0_LCD_EN
.set LcdDB7__MASK, 0x80
.set LcdDB7__PORT, 0
.set LcdDB7__PRT, CYREG_PRT0_PRT
.set LcdDB7__PRTDSI__CAPS_SEL, CYREG_PRT0_CAPS_SEL
.set LcdDB7__PRTDSI__DBL_SYNC_IN, CYREG_PRT0_DBL_SYNC_IN
.set LcdDB7__PRTDSI__OE_SEL0, CYREG_PRT0_OE_SEL0
.set LcdDB7__PRTDSI__OE_SEL1, CYREG_PRT0_OE_SEL1
.set LcdDB7__PRTDSI__OUT_SEL0, CYREG_PRT0_OUT_SEL0
.set LcdDB7__PRTDSI__OUT_SEL1, CYREG_PRT0_OUT_SEL1
.set LcdDB7__PRTDSI__SYNC_OUT, CYREG_PRT0_SYNC_OUT
.set LcdDB7__PS, CYREG_PRT0_PS
.set LcdDB7__SHIFT, 7
.set LcdDB7__SLW, CYREG_PRT0_SLW

/* LedRed */
.set LedRed__0__MASK, 0x80
.set LedRed__0__PC, CYREG_PRT12_PC7
.set LedRed__0__PORT, 12
.set LedRed__0__SHIFT, 7
.set LedRed__AG, CYREG_PRT12_AG
.set LedRed__BIE, CYREG_PRT12_BIE
.set LedRed__BIT_MASK, CYREG_PRT12_BIT_MASK
.set LedRed__BYP, CYREG_PRT12_BYP
.set LedRed__DM0, CYREG_PRT12_DM0
.set LedRed__DM1, CYREG_PRT12_DM1
.set LedRed__DM2, CYREG_PRT12_DM2
.set LedRed__DR, CYREG_PRT12_DR
.set LedRed__INP_DIS, CYREG_PRT12_INP_DIS
.set LedRed__MASK, 0x80
.set LedRed__PORT, 12
.set LedRed__PRT, CYREG_PRT12_PRT
.set LedRed__PRTDSI__DBL_SYNC_IN, CYREG_PRT12_DBL_SYNC_IN
.set LedRed__PRTDSI__OE_SEL0, CYREG_PRT12_OE_SEL0
.set LedRed__PRTDSI__OE_SEL1, CYREG_PRT12_OE_SEL1
.set LedRed__PRTDSI__OUT_SEL0, CYREG_PRT12_OUT_SEL0
.set LedRed__PRTDSI__OUT_SEL1, CYREG_PRT12_OUT_SEL1
.set LedRed__PRTDSI__SYNC_OUT, CYREG_PRT12_SYNC_OUT
.set LedRed__PS, CYREG_PRT12_PS
.set LedRed__SHIFT, 7
.set LedRed__SIO_CFG, CYREG_PRT12_SIO_CFG
.set LedRed__SIO_DIFF, CYREG_PRT12_SIO_DIFF
.set LedRed__SIO_HYST_EN, CYREG_PRT12_SIO_HYST_EN
.set LedRed__SIO_REG_HIFREQ, CYREG_PRT12_SIO_REG_HIFREQ
.set LedRed__SLW, CYREG_PRT12_SLW

/* LedBlue */
.set LedBlue__0__MASK, 0x20
.set LedBlue__0__PC, CYREG_PRT5_PC5
.set LedBlue__0__PORT, 5
.set LedBlue__0__SHIFT, 5
.set LedBlue__AG, CYREG_PRT5_AG
.set LedBlue__AMUX, CYREG_PRT5_AMUX
.set LedBlue__BIE, CYREG_PRT5_BIE
.set LedBlue__BIT_MASK, CYREG_PRT5_BIT_MASK
.set LedBlue__BYP, CYREG_PRT5_BYP
.set LedBlue__CTL, CYREG_PRT5_CTL
.set LedBlue__DM0, CYREG_PRT5_DM0
.set LedBlue__DM1, CYREG_PRT5_DM1
.set LedBlue__DM2, CYREG_PRT5_DM2
.set LedBlue__DR, CYREG_PRT5_DR
.set LedBlue__INP_DIS, CYREG_PRT5_INP_DIS
.set LedBlue__LCD_COM_SEG, CYREG_PRT5_LCD_COM_SEG
.set LedBlue__LCD_EN, CYREG_PRT5_LCD_EN
.set LedBlue__MASK, 0x20
.set LedBlue__PORT, 5
.set LedBlue__PRT, CYREG_PRT5_PRT
.set LedBlue__PRTDSI__CAPS_SEL, CYREG_PRT5_CAPS_SEL
.set LedBlue__PRTDSI__DBL_SYNC_IN, CYREG_PRT5_DBL_SYNC_IN
.set LedBlue__PRTDSI__OE_SEL0, CYREG_PRT5_OE_SEL0
.set LedBlue__PRTDSI__OE_SEL1, CYREG_PRT5_OE_SEL1
.set LedBlue__PRTDSI__OUT_SEL0, CYREG_PRT5_OUT_SEL0
.set LedBlue__PRTDSI__OUT_SEL1, CYREG_PRT5_OUT_SEL1
.set LedBlue__PRTDSI__SYNC_OUT, CYREG_PRT5_SYNC_OUT
.set LedBlue__PS, CYREG_PRT5_PS
.set LedBlue__SHIFT, 5
.set LedBlue__SLW, CYREG_PRT5_SLW

/* LedGreen */
.set LedGreen__0__MASK, 0x10
.set LedGreen__0__PC, CYREG_PRT5_PC4
.set LedGreen__0__PORT, 5
.set LedGreen__0__SHIFT, 4
.set LedGreen__AG, CYREG_PRT5_AG
.set LedGreen__AMUX, CYREG_PRT5_AMUX
.set LedGreen__BIE, CYREG_PRT5_BIE
.set LedGreen__BIT_MASK, CYREG_PRT5_BIT_MASK
.set LedGreen__BYP, CYREG_PRT5_BYP
.set LedGreen__CTL, CYREG_PRT5_CTL
.set LedGreen__DM0, CYREG_PRT5_DM0
.set LedGreen__DM1, CYREG_PRT5_DM1
.set LedGreen__DM2, CYREG_PRT5_DM2
.set LedGreen__DR, CYREG_PRT5_DR
.set LedGreen__INP_DIS, CYREG_PRT5_INP_DIS
.set LedGreen__LCD_COM_SEG, CYREG_PRT5_LCD_COM_SEG
.set LedGreen__LCD_EN, CYREG_PRT5_LCD_EN
.set LedGreen__MASK, 0x10
.set LedGreen__PORT, 5
.set LedGreen__PRT, CYREG_PRT5_PRT
.set LedGreen__PRTDSI__CAPS_SEL, CYREG_PRT5_CAPS_SEL
.set LedGreen__PRTDSI__DBL_SYNC_IN, CYREG_PRT5_DBL_SYNC_IN
.set LedGreen__PRTDSI__OE_SEL0, CYREG_PRT5_OE_SEL0
.set LedGreen__PRTDSI__OE_SEL1, CYREG_PRT5_OE_SEL1
.set LedGreen__PRTDSI__OUT_SEL0, CYREG_PRT5_OUT_SEL0
.set LedGreen__PRTDSI__OUT_SEL1, CYREG_PRT5_OUT_SEL1
.set LedGreen__PRTDSI__SYNC_OUT, CYREG_PRT5_SYNC_OUT
.set LedGreen__PS, CYREG_PRT5_PS
.set LedGreen__SHIFT, 4
.set LedGreen__SLW, CYREG_PRT5_SLW

/* LedYellow */
.set LedYellow__0__MASK, 0x40
.set LedYellow__0__PC, CYREG_PRT5_PC6
.set LedYellow__0__PORT, 5
.set LedYellow__0__SHIFT, 6
.set LedYellow__AG, CYREG_PRT5_AG
.set LedYellow__AMUX, CYREG_PRT5_AMUX
.set LedYellow__BIE, CYREG_PRT5_BIE
.set LedYellow__BIT_MASK, CYREG_PRT5_BIT_MASK
.set LedYellow__BYP, CYREG_PRT5_BYP
.set LedYellow__CTL, CYREG_PRT5_CTL
.set LedYellow__DM0, CYREG_PRT5_DM0
.set LedYellow__DM1, CYREG_PRT5_DM1
.set LedYellow__DM2, CYREG_PRT5_DM2
.set LedYellow__DR, CYREG_PRT5_DR
.set LedYellow__INP_DIS, CYREG_PRT5_INP_DIS
.set LedYellow__LCD_COM_SEG, CYREG_PRT5_LCD_COM_SEG
.set LedYellow__LCD_EN, CYREG_PRT5_LCD_EN
.set LedYellow__MASK, 0x40
.set LedYellow__PORT, 5
.set LedYellow__PRT, CYREG_PRT5_PRT
.set LedYellow__PRTDSI__CAPS_SEL, CYREG_PRT5_CAPS_SEL
.set LedYellow__PRTDSI__DBL_SYNC_IN, CYREG_PRT5_DBL_SYNC_IN
.set LedYellow__PRTDSI__OE_SEL0, CYREG_PRT5_OE_SEL0
.set LedYellow__PRTDSI__OE_SEL1, CYREG_PRT5_OE_SEL1
.set LedYellow__PRTDSI__OUT_SEL0, CYREG_PRT5_OUT_SEL0
.set LedYellow__PRTDSI__OUT_SEL1, CYREG_PRT5_OUT_SEL1
.set LedYellow__PRTDSI__SYNC_OUT, CYREG_PRT5_SYNC_OUT
.set LedYellow__PS, CYREG_PRT5_PS
.set LedYellow__SHIFT, 6
.set LedYellow__SLW, CYREG_PRT5_SLW

/* ClockCsBtns */
.set ClockCsBtns__CFG0, CYREG_CLKDIST_DCFG0_CFG0
.set ClockCsBtns__CFG1, CYREG_CLKDIST_DCFG0_CFG1
.set ClockCsBtns__CFG2, CYREG_CLKDIST_DCFG0_CFG2
.set ClockCsBtns__CFG2_SRC_SEL_MASK, 0x07
.set ClockCsBtns__INDEX, 0x00
.set ClockCsBtns__PM_ACT_CFG, CYREG_PM_ACT_CFG2
.set ClockCsBtns__PM_ACT_MSK, 0x01
.set ClockCsBtns__PM_STBY_CFG, CYREG_PM_STBY_CFG2
.set ClockCsBtns__PM_STBY_MSK, 0x01

/* IsrBtn0Pressed */
.set IsrBtn0Pressed__INTC_CLR_EN_REG, CYREG_NVIC_CLRENA0
.set IsrBtn0Pressed__INTC_CLR_PD_REG, CYREG_NVIC_CLRPEND0
.set IsrBtn0Pressed__INTC_MASK, 0x01
.set IsrBtn0Pressed__INTC_NUMBER, 0
.set IsrBtn0Pressed__INTC_PRIOR_NUM, 7
.set IsrBtn0Pressed__INTC_PRIOR_REG, CYREG_NVIC_PRI_0
.set IsrBtn0Pressed__INTC_SET_EN_REG, CYREG_NVIC_SETENA0
.set IsrBtn0Pressed__INTC_SET_PD_REG, CYREG_NVIC_SETPEND0

/* IsrBtn1Pressed */
.set IsrBtn1Pressed__INTC_CLR_EN_REG, CYREG_NVIC_CLRENA0
.set IsrBtn1Pressed__INTC_CLR_PD_REG, CYREG_NVIC_CLRPEND0
.set IsrBtn1Pressed__INTC_MASK, 0x02
.set IsrBtn1Pressed__INTC_NUMBER, 1
.set IsrBtn1Pressed__INTC_PRIOR_NUM, 7
.set IsrBtn1Pressed__INTC_PRIOR_REG, CYREG_NVIC_PRI_1
.set IsrBtn1Pressed__INTC_SET_EN_REG, CYREG_NVIC_SETENA0
.set IsrBtn1Pressed__INTC_SET_PD_REG, CYREG_NVIC_SETPEND0

/* ClockLcdBacklight */
.set ClockLcdBacklight__CFG0, CYREG_CLKDIST_DCFG1_CFG0
.set ClockLcdBacklight__CFG1, CYREG_CLKDIST_DCFG1_CFG1
.set ClockLcdBacklight__CFG2, CYREG_CLKDIST_DCFG1_CFG2
.set ClockLcdBacklight__CFG2_SRC_SEL_MASK, 0x07
.set ClockLcdBacklight__INDEX, 0x01
.set ClockLcdBacklight__PM_ACT_CFG, CYREG_PM_ACT_CFG2
.set ClockLcdBacklight__PM_ACT_MSK, 0x02
.set ClockLcdBacklight__PM_STBY_CFG, CYREG_PM_STBY_CFG2
.set ClockLcdBacklight__PM_STBY_MSK, 0x02

/* Miscellaneous */
.set BCLK__BUS_CLK__HZ, 24000000
.set BCLK__BUS_CLK__KHZ, 24000
.set BCLK__BUS_CLK__MHZ, 24
.set CYDEV_CHIP_DIE_GEN4, 2
.set CYDEV_CHIP_DIE_LEOPARD, 1
.set CYDEV_CHIP_DIE_PANTHER, 13
.set CYDEV_CHIP_DIE_PSOC4A, 6
.set CYDEV_CHIP_DIE_PSOC5LP, 12
.set CYDEV_CHIP_DIE_UNKNOWN, 0
.set CYDEV_CHIP_FAMILY_PSOC3, 1
.set CYDEV_CHIP_FAMILY_PSOC4, 2
.set CYDEV_CHIP_FAMILY_PSOC5, 3
.set CYDEV_CHIP_FAMILY_UNKNOWN, 0
.set CYDEV_CHIP_FAMILY_USED, CYDEV_CHIP_FAMILY_PSOC5
.set CYDEV_CHIP_JTAG_ID, 0x2E178069
.set CYDEV_CHIP_MEMBER_3A, 1
.set CYDEV_CHIP_MEMBER_4A, 6
.set CYDEV_CHIP_MEMBER_4C, 10
.set CYDEV_CHIP_MEMBER_4D, 3
.set CYDEV_CHIP_MEMBER_4E, 5
.set CYDEV_CHIP_MEMBER_4F, 7
.set CYDEV_CHIP_MEMBER_4G, 2
.set CYDEV_CHIP_MEMBER_4H, 4
.set CYDEV_CHIP_MEMBER_4L, 9
.set CYDEV_CHIP_MEMBER_4M, 8
.set CYDEV_CHIP_MEMBER_5A, 12
.set CYDEV_CHIP_MEMBER_5B, 11
.set CYDEV_CHIP_MEMBER_UNKNOWN, 0
.set CYDEV_CHIP_MEMBER_USED, CYDEV_CHIP_MEMBER_5B
.set CYDEV_CHIP_DIE_EXPECT, CYDEV_CHIP_MEMBER_USED
.set CYDEV_CHIP_DIE_ACTUAL, CYDEV_CHIP_DIE_EXPECT
.set CYDEV_CHIP_REV_GEN4_ES, 17
.set CYDEV_CHIP_REV_GEN4_ES2, 33
.set CYDEV_CHIP_REV_GEN4_PRODUCTION, 17
.set CYDEV_CHIP_REV_LEOPARD_ES1, 0
.set CYDEV_CHIP_REV_LEOPARD_ES2, 1
.set CYDEV_CHIP_REV_LEOPARD_ES3, 3
.set CYDEV_CHIP_REV_LEOPARD_PRODUCTION, 3
.set CYDEV_CHIP_REV_PANTHER_ES0, 0
.set CYDEV_CHIP_REV_PANTHER_ES1, 1
.set CYDEV_CHIP_REV_PANTHER_PRODUCTION, 1
.set CYDEV_CHIP_REV_PSOC4A_ES0, 17
.set CYDEV_CHIP_REV_PSOC4A_PRODUCTION, 17
.set CYDEV_CHIP_REV_PSOC5LP_ES0, 0
.set CYDEV_CHIP_REV_PSOC5LP_PRODUCTION, 0
.set CYDEV_CHIP_REVISION_3A_ES1, 0
.set CYDEV_CHIP_REVISION_3A_ES2, 1
.set CYDEV_CHIP_REVISION_3A_ES3, 3
.set CYDEV_CHIP_REVISION_3A_PRODUCTION, 3
.set CYDEV_CHIP_REVISION_4A_ES0, 17
.set CYDEV_CHIP_REVISION_4A_PRODUCTION, 17
.set CYDEV_CHIP_REVISION_4C_PRODUCTION, 0
.set CYDEV_CHIP_REVISION_4D_PRODUCTION, 0
.set CYDEV_CHIP_REVISION_4E_PRODUCTION, 0
.set CYDEV_CHIP_REVISION_4F_PRODUCTION, 0
.set CYDEV_CHIP_REVISION_4F_PRODUCTION_256K, 0
.set CYDEV_CHIP_REVISION_4G_ES, 17
.set CYDEV_CHIP_REVISION_4G_ES2, 33
.set CYDEV_CHIP_REVISION_4G_PRODUCTION, 17
.set CYDEV_CHIP_REVISION_4H_PRODUCTION, 0
.set CYDEV_CHIP_REVISION_4L_PRODUCTION, 0
.set CYDEV_CHIP_REVISION_4M_PRODUCTION, 0
.set CYDEV_CHIP_REVISION_5A_ES0, 0
.set CYDEV_CHIP_REVISION_5A_ES1, 1
.set CYDEV_CHIP_REVISION_5A_PRODUCTION, 1
.set CYDEV_CHIP_REVISION_5B_ES0, 0
.set CYDEV_CHIP_REVISION_5B_PRODUCTION, 0
.set CYDEV_CHIP_REVISION_USED, CYDEV_CHIP_REVISION_5B_PRODUCTION
.set CYDEV_CHIP_REV_EXPECT, CYDEV_CHIP_REVISION_USED
.set CYDEV_CONFIG_FASTBOOT_ENABLED, 1
.set CYDEV_CONFIG_UNUSED_IO_AllowButWarn, 0
.set CYDEV_CONFIG_UNUSED_IO, CYDEV_CONFIG_UNUSED_IO_AllowButWarn
.set CYDEV_CONFIG_UNUSED_IO_AllowWithInfo, 1
.set CYDEV_CONFIG_UNUSED_IO_Disallowed, 2
.set CYDEV_CONFIGURATION_COMPRESSED, 1
.set CYDEV_CONFIGURATION_DMA, 0
.set CYDEV_CONFIGURATION_ECC, 1
.set CYDEV_CONFIGURATION_IMOENABLED, CYDEV_CONFIG_FASTBOOT_ENABLED
.set CYDEV_CONFIGURATION_MODE_COMPRESSED, 0
.set CYDEV_CONFIGURATION_MODE, CYDEV_CONFIGURATION_MODE_COMPRESSED
.set CYDEV_CONFIGURATION_MODE_DMA, 2
.set CYDEV_CONFIGURATION_MODE_UNCOMPRESSED, 1
.set CYDEV_DEBUG_ENABLE_MASK, 0x20
.set CYDEV_DEBUG_ENABLE_REGISTER, CYREG_MLOGIC_DEBUG
.set CYDEV_DEBUGGING_DPS_Disable, 3
.set CYDEV_DEBUGGING_DPS, CYDEV_DEBUGGING_DPS_Disable
.set CYDEV_DEBUGGING_DPS_JTAG_4, 1
.set CYDEV_DEBUGGING_DPS_JTAG_5, 0
.set CYDEV_DEBUGGING_DPS_SWD, 2
.set CYDEV_DEBUGGING_DPS_SWD_SWV, 6
.set CYDEV_DEBUGGING_ENABLE, 1
.set CYDEV_DEBUGGING_XRES, 0
.set CYDEV_DMA_CHANNELS_AVAILABLE, 24
.set CYDEV_ECC_ENABLE, 1
.set CYDEV_HEAP_SIZE, 0x80
.set CYDEV_INSTRUCT_CACHE_ENABLED, 1
.set CYDEV_INTR_RISING, 0x00000003
.set CYDEV_PROJ_TYPE, 2
.set CYDEV_PROJ_TYPE_BOOTLOADER, 1
.set CYDEV_PROJ_TYPE_LAUNCHER, 5
.set CYDEV_PROJ_TYPE_LOADABLE, 2
.set CYDEV_PROJ_TYPE_LOADABLEANDBOOTLOADER, 4
.set CYDEV_PROJ_TYPE_MULTIAPPBOOTLOADER, 3
.set CYDEV_PROJ_TYPE_STANDARD, 0
.set CYDEV_PROTECTION_ENABLE, 0
.set CYDEV_STACK_SIZE, 0x0800
.set CYDEV_USE_BUNDLED_CMSIS, 1
.set CYDEV_VARIABLE_VDDA, 0
.set CYDEV_VDDA_MV, 5000
.set CYDEV_VDDD_MV, 5000
.set CYDEV_VDDIO0_MV, 5000
.set CYDEV_VDDIO1_MV, 3300
.set CYDEV_VDDIO2_MV, 3300
.set CYDEV_VDDIO3_MV, 5000
.set CYDEV_VIO0_MV, 5000
.set CYDEV_VIO1_MV, 3300
.set CYDEV_VIO2_MV, 3300
.set CYDEV_VIO3_MV, 5000
.set CYIPBLOCK_ARM_CM3_VERSION, 0
.set CYIPBLOCK_P3_ANAIF_VERSION, 0
.set CYIPBLOCK_P3_CAPSENSE_VERSION, 0
.set CYIPBLOCK_P3_COMP_VERSION, 0
.set CYIPBLOCK_P3_DMA_VERSION, 0
.set CYIPBLOCK_P3_DRQ_VERSION, 0
.set CYIPBLOCK_P3_EMIF_VERSION, 0
.set CYIPBLOCK_P3_I2C_VERSION, 0
.set CYIPBLOCK_P3_LCD_VERSION, 0
.set CYIPBLOCK_P3_LPF_VERSION, 0
.set CYIPBLOCK_P3_OPAMP_VERSION, 0
.set CYIPBLOCK_P3_PM_VERSION, 0
.set CYIPBLOCK_P3_SCCT_VERSION, 0
.set CYIPBLOCK_P3_TIMER_VERSION, 0
.set CYIPBLOCK_P3_USB_VERSION, 0
.set CYIPBLOCK_P3_VIDAC_VERSION, 0
.set CYIPBLOCK_P3_VREF_VERSION, 0
.set CYIPBLOCK_S8_GPIO_VERSION, 0
.set CYIPBLOCK_S8_IRQ_VERSION, 0
.set CYIPBLOCK_S8_SAR_VERSION, 0
.set CYIPBLOCK_S8_SIO_VERSION, 0
.set CYIPBLOCK_S8_UDB_VERSION, 0
.set DMA_CHANNELS_USED__MASK0, 0x00000000
.set CYDEV_BOOTLOADER_ENABLE, 0
.endif
